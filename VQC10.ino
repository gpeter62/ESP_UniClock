#ifdef VQC10
char tubeDriver[] = "VQC10";
#define NUMDIGITS 8
int maxDigits = NUMDIGITS;

//Please, set the pin numbers in clock.h!
//#define latchPin  5 //D2 RCK
//#define clockPin  4 //D1 SCK
//#define dataPin   2 //D4 DIN
//#define ledOffpin 0 //D5
//#define D5pin  14


#define NUMCOLS 5
#define NUMROWS 7

boolean _upsidedown = false;
byte row[NUMROWS];

char asciiConvert[] = "0123456789 -.APC~%oIF";
char DPchar = 0xFF;  //decimal point

char cDigit[NUMDIGITS+1] = "76543210";
byte  dat[NUMDIGITS][NUMROWS];
byte  oldDat[NUMDIGITS][NUMROWS];
byte  newDat[NUMDIGITS][NUMROWS];

// standard ascii 5x7 font incl. the IPM-PC extension:
// already defined in DotMatrx5x7.h
//#define aUML "\x84" // ä = 0x84
//#define oUML "\x94" // ö = 0x94
//#define uUML "\x81" // ü = 0x81
//#define sZET "\xE1" // ß = 0xE1
//#define AUML "\x8E" // Ä = 0x8E
//#define OUML "\x99" // Ö = 0x99
//#define UUML "\x9A" // Ü = 0x9A

byte  _font[] = {
  0x00, 0x00, 0x00, 0x00, 0x00, // 0x00 empty
  0x3E, 0x5B, 0x4F, 0x5B, 0x3E, // 0x01 sad
  0x3E, 0x6B, 0x4F, 0x6B, 0x3E, // 0x02 happy
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  0x06, 0x09, 0x7F, 0x01, 0x7F, // 0x14 paragraph end sign (pilcrow)
  // 0x00, 0x66, 0x89, 0x95, 0x6A, // 0x15 paragraph sign original
  0x00, 0x26, 0x49, 0x55, 0x28, // 0x15 paragraph sign
  0x60, 0x60, 0x60, 0x60, 0x60, // 0x16 double underline
  0x54, 0x62, 0x7F, 0x62, 0x54, // 0x17 up/down arrow with underline
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  0x00, 0x08, 0x7E, 0x09, 0x02, // 0x66 f
  // 0x18, 0xA4, 0xA4, 0x9C, 0x78, // 0x67 g (old)
  0x0C, 0x52, 0x52, 0x4E, 0x3C, // 0x67 g 
  0x7F, 0x08, 0x04, 0x04, 0x78, // 0x68 h
  0x00, 0x44, 0x7D, 0x40, 0x00, // 0x69 i
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  0xFC, 0x18, 0x24, 0x24, 0x18, // 0x70 p
  // 0x18, 0x24, 0x24, 0x18, 0xFC, // 0x71 q (old)
  0x0C, 0x12, 0x12, 0x0C, 0x7E, // 0x71 q
  0x7C, 0x08, 0x04, 0x04, 0x08, // 0x72 r
  0x48, 0x54, 0x54, 0x54, 0x24, // 0x73 s
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  0x00, 0x9D, 0xA0, 0xA0, 0x7D, // 0x98
  //0x39, 0x44, 0x44, 0x44, 0x39, // 0x99 Ö (old)
  0x3D, 0x42, 0x42, 0x42, 0x3D, // 0x99 Ö
  0x3D, 0x40, 0x40, 0x40, 0x3D, // 0x9A Ü
  0x3C, 0x24, 0xFF, 0x24, 0x24, // 0x9B cent
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  0x00, 0x3C, 0x3C, 0x3C, 0x3C, // 0xFE blob
  //0x00, 0x00, 0x00, 0x60, 0x60, // // 0xFF: Decimal point: 4 points
  0x00, 0x00, 0x00, 0x00, 0x40, // // 0xFF: Decimal point, only 1 point
};

void setup_pins() {
  DPRINTLN("VQC10 Clock - setup 74HC595 pins");
  pinMode(latchPin, OUTPUT);  regPin(latchPin,"latchPin");
  pinMode(dataPin,OUTPUT);    regPin(dataPin,"dataPin");
  pinMode(clockPin,OUTPUT);   regPin(clockPin,"clockPin");
  pinMode(D5pin,INPUT);       regPin(D5pin,"D5pin");
  digitsOnly = false;
  asciiConvert[16] = 9;
}

void inline shiftOutForward(byte myDataOut) {
  // This shifts 8 bits out MSB first, on the rising edge of the clock, clock idles low
  for (int i=7; i>=0; i--)  {
    digitalWrite(clockPin, 0);
    digitalWrite(dataPin, myDataOut & (1<<i)); //register shifts bits on upstroke of clock pin
    digitalWrite(clockPin, 1);
    digitalWrite(dataPin, 0);
  }
}

void inline shiftOutReverse(byte myDataOut) {
  // This shifts 8 bits out LSB first, on the rising edge of the clock, clock idles low
  for (int i=0; i<8; i++)  {
    digitalWrite(clockPin, 0);
    digitalWrite(dataPin, myDataOut & (1<<i)); //register shifts bits on upstroke of clock pin
    digitalWrite(clockPin, 1);
    digitalWrite(dataPin, 0);
  }
}



#define PWMrefresh 8000l

void ICACHE_RAM_ATTR writeDisplay() {}


int PWM_min = 0;
int PWM_max = 800;

void writeDisplay2() {
static  int PWMtimeBrightness;
//static uint32_t refresh = 0;
//static uint32_t runtim = 0;
//static uint32_t laststart = 0;
boolean offState;
int brightness;
int iRow,loopMax;
  
  
  //refresh = millis()-laststart;
  //laststart = millis();
  //runtim = laststart;

  brightness = displayON ? prm.dayBright : prm.nightBright;
  if (brightness>MAXBRIGHTNESS) brightness = MAXBRIGHTNESS;  //only for safety

  if (autoBrightness && displayON) {  
    PWMtimeBrightness = max(PWM_min,PWM_max*lx/MAXIMUM_LUX);
    }
  else
    PWMtimeBrightness = max(PWM_min,PWM_max*brightness/MAXBRIGHTNESS);
  
  iRow = 0;
  loopMax = maxDigits;
  do {
  offState = ( (brightness == 0) || (!radarON) || (iRow == maxDigits));  
 
  for (int i=0;i<NUMDIGITS;i++) { //fill one line with dots
      shiftOutForward(0xFF);     //deselect Z
      shiftOutForward(~(1<<i));  //select digit
      shiftOutReverse(offState ? 0 : dat[i][iRow]);  // set data line
      digitalWrite(latchPin, HIGH); //Write shift register to latch
      digitalWrite(latchPin, LOW);   
      asm volatile ("nop");
      
      //Finish latching
      shiftOutForward(0xFF);   //deselect Z
      shiftOutForward(0xFF);  //All digit select lines are HIGH
      shiftOutReverse(offState ? 0 : dat[i][iRow]);  //keep data line
      digitalWrite(latchPin, HIGH); //Write shift register to latch
      digitalWrite(latchPin, LOW); 
      asm volatile ("nop");
  }

  shiftOutForward(~(1<<iRow)); //enable row
  shiftOutForward(0xFF);     //All digit select lines are HIGH
  shiftOutForward(0);        //anything
  digitalWrite(latchPin, HIGH); //Write shift register to latch
  digitalWrite(latchPin, LOW);
  if (!offState) 
    delayMicroseconds(PWMtimeBrightness);
  else
    delayMicroseconds(PWM_max-PWMtimeBrightness);  
  
  iRow++;
  } while(iRow<loopMax);
    
  //runtim = millis()-runtim;
  //DPRINT(refresh); DPRINT("/"); DPRINTLN(runtim); 
  yield();
}


void show(byte c){
  byte loccol[NUMCOLS];
  for (byte i=0; i < NUMCOLS; i++)
    loccol[i] = _font[c*NUMCOLS+i];
  transposePattern(loccol,row);
}

void transposePattern(byte cols[], volatile byte rows[]){
  byte cmask;
  cmask = (_upsidedown ? 0x40 : 1);
  for (byte r=0; r < NUMROWS; r++) {
    rows[r] = 0;
    for (byte c=0; c < NUMCOLS; c++) {
      if (cmask&cols[(_upsidedown ? (NUMCOLS-c-1) : c)]) rows[r] |= 1;
      rows[r] = rows[r] << 1;
    }
    if (_upsidedown) cmask = cmask >> 1;
    else cmask = cmask << 1;
    rows[r] = rows[r] << (7-NUMCOLS);
  }
}

void bPrint(byte in) {
  for (int i=7;i>=0;i--) {
    boolean b = in & (1<<i);
    DPRINT(b ? '1' : '0');
  }
}

void printBitmap() {  //print bitmap for testing
  for (int j=0;j<NUMROWS;j++) {
    for (int i=0;i<NUMDIGITS;i++) {
      bPrint(dat[i][j]); Serial.print(" ");
    }
    DPRINTLN(" ");
  }
  DPRINTLN("__________________________________");
}


void clearTubes() {}

void writeDisplaySingle() {
  char dispChar;
  byte tubeShift[] = {3,2,1,0,7,6,5,4}; 
  byte a;
  for (int i=0;i<NUMDIGITS;i++) {   //generate new line
    dispChar = digit[tubeShift[i]];
    if (dispChar<sizeof(asciiConvert)) dispChar = asciiConvert[(byte)dispChar]; 
    show(dispChar); 
    for (int k=0;k<NUMROWS;k++) {
      oldDat[i][k] = row[k];
    }
    if (digitDP[tubeShift[i]]) {
      show(DPchar); 
      for (int k=0;k<NUMROWS;k++) {
        oldDat[i][k] |= row[k];
      }
    }
  }
  for (int i=0;i<NUMDIGITS;i++) {  //generate old line
    dispChar = newDigit[tubeShift[i]];
    if (dispChar<sizeof(asciiConvert)) dispChar = asciiConvert[(byte)dispChar]; 
    show(dispChar); 
    for (int k=0;k<NUMROWS;k++) {
      newDat[i][k] = row[k];
    }
    if (digitDP[tubeShift[i]]) {
      show(DPchar); 
      for (int k=0;k<NUMROWS;k++) {
        newDat[i][k] |= row[k];
      }
    }
  }

  for (int i=0;i<NUMDIGITS;i++) {  //combine animation
    a = animMask[tubeShift[i]]/2;   if (a>7) a=7;
    for (int k=0;k<NUMROWS;k++) {
      if (a==0) dat[i][k] = oldDat[i][k];
      else {   //Animation!!!
        if ((a+k)<NUMROWS) { 
          dat[i][k] = oldDat[i][k+a];   
        }
        else {
          dat[i][k] = newDat[i][(k+a)-NUMROWS];
        }
      }  //endif Animation!!
    } //end for i
  } //end for 
  //printBitmap();
}

#endif
